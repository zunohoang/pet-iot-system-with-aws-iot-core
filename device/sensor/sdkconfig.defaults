## device/sensor/sdkconfig.defaults
```kconfig
CONFIG_BT_ENABLED=y
CONFIG_BT_NIMBLE_ENABLED=y
CONFIG_BT_NIMBLE_MEM_ALLOC_MODE_INTERNAL=y

# Partition Table - Match Switch (Large App)
CONFIG_PARTITION_TABLE_SINGLE_APP_LARGE=y
CONFIG_PARTITION_TABLE_CUSTOM=n

# Flash Size - Match Switch
CONFIG_ESPTOOLPY_FLASHSIZE_4MB=y
CONFIG_ESPTOOLPY_FLASHSIZE="4MB"

# Optimization
CONFIG_COMPILER_OPTIMIZATION_SIZE=y

# Stack & Stability
CONFIG_ESP_MAIN_TASK_STACK_SIZE=8192
CONFIG_ESP_SYSTEM_EVENT_QUEUE_SIZE=32
CONFIG_SPI_FLASH_SUPPORT_BOYA_CHIP=y

# Coexistence (Bluetooth and WiFi)
CONFIG_ESP32_WIFI_SW_COEXIST_ENABLE=y
```
